## conf/machine/sama5d2-roadrunner-bertad2-qspi.conf
```bitbake
#@TYPE: Machine
#@Name: ACME Roadrunner on Berta D2 baseboard
#@DESCRIPTION: Machine configuration for ACME Roadrunner on Berta D2 baseboard

require sama5d2-roadrunner.inc

IMAGE_FSTYPES += " jffs2 ubi"

# # 16 MiB qspi flash
# # TODO: calculate 65536 - 128
# MKUBIFS_ARGS = "-m 1 -e 65408 -c 190 -F"
# UBINIZE_ARGS = "-m 1 -p 64KiB"

# 128 MiB qspi flash
MKUBIFS_ARGS = "-m 1 -e 65408 -c 1976 -F"
UBINIZE_ARGS = "-m 1 -p 64KiB"

JFFS2_ERASEBLOCK = "0x1000"
EXTRA_IMAGECMD_jffs2 = "${JFFS2_ENDIANNESS} --eraseblock=${JFFS2_ERASEBLOCK} --no-cleanmarkers"
```

## conf/machine/sama5d2-roadrunner.inc
```bitbake
#@TYPE: Machine
#@Name: ACME Roadrunner on Berta D2 baseboard
#@DESCRIPTION: Machine configuration for ACME Roadrunner on Berta D2 baseboard

AT91BOOTSTRAP_MACHINE ?= "sama5d2_roadrunner"
require conf/machine/include/sama5d2.inc

MACHINE_FEATURES = "kernel26 apm ext4 usbhost usbgadget can ppp"
KERNEL_DEVICETREE = " \
		${MACHINE}.dtb \
		"
IMAGE_FSTYPES += " tar.xz"

EXTRA_IMAGEDEPENDS_remove = "virtual/bootloader"
IMAGE_BOOTLOADER = ""
```
